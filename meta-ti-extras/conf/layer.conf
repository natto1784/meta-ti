## meta-ti-extras/conf/layer.conf
```bitbake
# We have a conf and classes directory, append to BBPATH
BBPATH .= ":${LAYERDIR}"
METATIBASE := '${@os.path.normpath("${LAYERDIR}/")}'

# We have a recipes directory, add to BBFILES
BBFILES += "${LAYERDIR}/recipes*/*/*.bb ${LAYERDIR}/recipes*/*/*.bbappend"

# We have dynamic layers, add to BBFILES_DYNAMIC
BBFILES_DYNAMIC += " \
    virtualization-layer:${LAYERDIR}/dynamic-layers/virtualization-layer/*/*/*.bb \
    virtualization-layer:${LAYERDIR}/dynamic-layers/virtualization-layer/*/*/*.bbappend \
"

BBFILE_COLLECTIONS += "meta-ti-extras"
BBFILE_PATTERN_meta-ti-extras := "^${LAYERDIR}/"
BBFILE_PRIORITY_meta-ti-extras = "6"

LAYERSERIES_COMPAT_meta-ti-extras = "scarthgap"

LICENSE_PATH += "${LAYERDIR}/licenses"

LAYERDEPENDS_meta-ti-extras = " \
    meta-ti-bsp \
"
```
